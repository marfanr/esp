## components/lora/Kconfig.projbuild
```kconfig
menu "Konfigurasi LORA"
    config LORA_CS_PIN
        int "GPIO CS Pin"
        range 0 39
        default 18
        help
            Pin CS untuk SPI modul LoRa
    
    config LORA_RST_PIN
        int "GPIO RST Pin"
        range 0 39
        default 14
        help
            Pin RST untuk RESET modul LoRa

    config LORA_MISO_PIN
        int "GPIO MISO Pin"
        range 0 39
        default 12
        help
            Pin MISO untuk SPI modul LoRa
    
    config LORA_MOSI_PIN
        int "GPIO MOSI Pin"
        range 0 39
        default 13
        help
            Pin MOSI untuk SPI modul LoRa

    config LORA_SCLK_PIN
        int "GPIO SCLK Pin"
        range 0 39
        default 15
        help
            Pin SCLK untuk SPI modul LoRa

    config LORA_IRQ_PIN
        int "GPIO IRQ Pin"
        range 0 39
        default 16
        help
            Pin IRQ untuk modul LoRa

    config LORA_SPI_CLOCK_HZ
        int "SPI Clock Speed (Hz)"
        range 1000000 10000000
        default 9000000
        help
            Kecepatan clock SPI untuk komunikasi dengan modul LoRa
endmenu
```

## components/soil7in1/Kconfig.projbuild
```kconfig
menu "Konfigurasi Sensor"
    config SENSOR_TX_PIN
        int "GPIO TX Pin"
        range 0 39
        default 2
        help
            pin TX untuk sensor 7in1 soil

    config SENSOR_RX_PIN
        int "GPIO RX Pin"
        range 0 39
        default 4
        help
            pin RX untuk sensor 7in1 soil
    
    
endmenu
```
